## Config.in
```kconfig
source "$BR2_EXTERNAL_OSUKIOSK_PATH/package/latency-probe/Config.in"
source "$BR2_EXTERNAL_OSUKIOSK_PATH/package/osu-lazer/Config.in"
```

## package/latency-probe/Config.in
```kconfig
config BR2_PACKAGE_LATENCY_PROBE
	bool "latency-probe"
	depends on BR2_PACKAGE_WAYLAND
	select BR2_PACKAGE_WAYLAND_PROTOCOLS
	help
	  Input latency test tools for osu!kiosk Stage 5 Step D
	  (development only). latency-probe is a full-screen Wayland
	  client that flips between black and white on every key or
	  button press and logs the input-to-presentation latency of
	  each press (wp_presentation). latency-probe-vt does the same
	  flip on the Linux console, with no Wayland stack, as the
	  reference point.

comment "latency-probe needs wayland"
	depends on !BR2_PACKAGE_WAYLAND
```

## package/osu-lazer/Config.in
```kconfig
config BR2_PACKAGE_OSU_LAZER
	bool "osu-lazer"
	depends on BR2_x86_64
	depends on BR2_TOOLCHAIN_USES_GLIBC
	depends on BR2_INSTALL_LIBSTDCPP # icu
	depends on BR2_USE_WCHAR # icu
	depends on BR2_TOOLCHAIN_GCC_AT_LEAST_7 # icu
	depends on BR2_HOST_GCC_AT_LEAST_7 # icu
	depends on BR2_TOOLCHAIN_HAS_THREADS # icu, libglvnd, wayland
	depends on BR2_TOOLCHAIN_HAS_SYNC_4 # libglvnd
	depends on !BR2_STATIC_LIBS # libglvnd, wayland
	# What the game loads from the system at run time; everything else
	# (the .NET runtime, SDL3, BASS, FFmpeg, Realm) comes in the release.
	select BR2_PACKAGE_ALSA_LIB # BASS audio output
	select BR2_PACKAGE_ICU # .NET globalization, it aborts without ICU
	select BR2_PACKAGE_LIBGLVND # libOpenGL.so.0 for SDL3's OpenGL context
	select BR2_PACKAGE_LIBXKBCOMMON # SDL3 Wayland keyboard input
	select BR2_PACKAGE_OPENSSL # .NET hashing (MD5, SHA) and TLS
	select BR2_PACKAGE_WAYLAND # SDL3 video output
	help
	  osu!lazer, the free-to-play rhythm game, installed to
	  /opt/osu-lazer from its official Linux release: an AppImage
	  with a self-contained .NET runtime and the native libraries
	  the game uses (SDL3, BASS, FFmpeg, Realm) inside. The AppImage
	  is unpacked at build time and never run on the build host.

	  At run time the game needs a Wayland compositor and a Mesa
	  driver with an OpenGL 3.2 core profile, which SDL3 opens
	  through EGL.

	  https://osu.ppy.sh/
	  https://github.com/ppy/osu

comment "osu-lazer needs an x86_64 glibc toolchain w/ C++, wchar, threads, dynamic library, gcc >= 7"
	depends on BR2_x86_64
	depends on !BR2_TOOLCHAIN_USES_GLIBC || !BR2_INSTALL_LIBSTDCPP || \
		!BR2_USE_WCHAR || !BR2_TOOLCHAIN_GCC_AT_LEAST_7 || \
		!BR2_TOOLCHAIN_HAS_THREADS || BR2_STATIC_LIBS
```
