## configs/osukiosk_initramfs_defconfig
```kconfig
BR2_x86_64=y
BR2_ROOTFS_OVERLAY="$(BR2_EXTERNAL_OSUKIOSK_PATH)/board/osukiosk/initramfs-overlay"
BR2_TARGET_ROOTFS_CPIO=y
BR2_TARGET_ROOTFS_CPIO_GZIP=y
# BR2_TARGET_ROOTFS_TAR is not set
```

## configs/osukiosk_main_defconfig
```kconfig
BR2_x86_64=y
BR2_KERNEL_HEADERS_7_0=y
BR2_TOOLCHAIN_BUILDROOT_CXX=y
BR2_TARGET_GENERIC_HOSTNAME="osukiosk"
BR2_TARGET_GENERIC_ISSUE="Welcome to osu!kiosk"
BR2_ROOTFS_DEVICE_CREATION_DYNAMIC_EUDEV=y
# BR2_TARGET_GENERIC_GETTY is not set
BR2_ROOTFS_USERS_TABLES="$(BR2_EXTERNAL_OSUKIOSK_PATH)/board/osukiosk/users-table.txt"
BR2_ROOTFS_OVERLAY="$(BR2_EXTERNAL_OSUKIOSK_PATH)/board/osukiosk/rootfs-overlay"
BR2_LINUX_KERNEL=y
BR2_LINUX_KERNEL_CUSTOM_VERSION=y
BR2_LINUX_KERNEL_CUSTOM_VERSION_VALUE="6.18.48"
BR2_LINUX_KERNEL_USE_CUSTOM_CONFIG=y
BR2_LINUX_KERNEL_CUSTOM_CONFIG_FILE="$(BR2_EXTERNAL_OSUKIOSK_PATH)/board/osukiosk/linux.config"
BR2_PACKAGE_CAGE=y
BR2_PACKAGE_SWAYBG=y
BR2_PACKAGE_MESA3D=y
BR2_PACKAGE_MESA3D_LLVM=y
BR2_PACKAGE_MESA3D_GALLIUM_DRIVER_IRIS=y
BR2_PACKAGE_MESA3D_OPENGL_EGL=y
BR2_PACKAGE_MESA3D_OPENGL_ES=y
BR2_PACKAGE_SEATD_DAEMON=y
BR2_TARGET_ROOTFS_SQUASHFS=y
BR2_TARGET_ROOTFS_SQUASHFS4_XZ=y
# BR2_TARGET_ROOTFS_TAR is not set
```
